## conf/layer.conf
```bitbake
# We have a conf and classes directory, add to BBPATH
BBPATH .= ":${LAYERDIR}"

# We have recipes-* directories, add to BBFILES
BBFILES += "${LAYERDIR}/recipes-*/*/*.bb \
            ${LAYERDIR}/recipes-*/*/*.bbappend"

BBFILE_COLLECTIONS += "meta-krystian"
BBFILE_PATTERN_meta-krystian = "^${LAYERDIR}/"
BBFILE_PRIORITY_meta-krystian = "6"

LAYERDEPENDS_meta-krystian = "core"
LAYERSERIES_COMPAT_meta-krystian = "kirkstone"
```
